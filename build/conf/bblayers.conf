## build/conf/bblayers.conf
```bitbake
# POKY_BBLAYERS_CONF_VERSION is increased each time build/conf/bblayers.conf
# changes incompatibly
POKY_BBLAYERS_CONF_VERSION = "2"

BBPATH = "${TOPDIR}"
BBFILES ?= ""

BBLAYERS ?= " \
  /work/yocto/sources/meta-rauc \
  /work/yocto/sources/poky/meta \
  /work/yocto/sources/poky/meta-poky \
  /work/yocto/sources/poky/../meta-openembedded/meta-oe \
  /work/yocto/sources/poky/../meta-openembedded/meta-python \
  /work/yocto/sources/poky/../meta-openembedded/meta-filesystems \
  /work/yocto/sources/poky/../meta-openembedded/meta-networking \
  /work/yocto/sources/poky/../meta-openembedded/meta-multimedia \
  /work/yocto/sources/poky/../meta-virtualization \
  /work/yocto/sources/poky/../meta-security \
  /work/yocto/sources/poky/../meta-security/meta-tpm \
  /work/yocto/sources/poky/../meta-xilinx/meta-xilinx-core \
  /work/yocto/sources/poky/../meta-xilinx/meta-xilinx-standalone \
  /work/yocto/sources/poky/../meta-xilinx/meta-xilinx-standalone-sdt \
  /work/yocto/sources/poky/../meta-xilinx/meta-xilinx-multimedia \
  /work/yocto/sources/poky/../meta-xilinx/meta-xilinx-demos \
  /work/yocto/sources/poky/../meta-xilinx/meta-xilinx-virtualization \
  /work/yocto/sources/poky/../meta-xilinx/meta-xilinx-mali400 \
  /work/yocto/sources/poky/../meta-xilinx/meta-xilinx-gpu-malig78ae \
  /work/yocto/sources/poky/../meta-xilinx/meta-microblaze \
  /work/yocto/sources/poky/../meta-xilinx-tsn \
  /work/yocto/sources/poky/../meta-openamp \
  /work/yocto/sources/poky/../meta-amd-edf \
  /work/yocto/sources/poky/../meta-kria \
  /work/yocto/sources/poky/../meta-amd-adaptive-socs/meta-amd-adaptive-socs-core \
  /work/yocto/sources/poky/../meta-amd-adaptive-socs/meta-amd-adaptive-socs-bsp \
  /work/yocto/sources/poky/../meta-xilinx/meta-xilinx-imgrcvry \
  /work/yocto/sources/poky/../meta-arm/meta-arm \
  /work/yocto/sources/poky/../meta-arm/meta-arm-toolchain \
  /work/yocto/sources/poky/../meta-jupyter \
  /work/yocto/sources/poky/../meta-ros/meta-ros-common \
  /work/yocto/sources/poky/../meta-ros/meta-ros2 \
  /work/yocto/sources/poky/../meta-ros/meta-ros2-jazzy \
  /work/yocto/sources/poky/../meta-qt5 \
  /work/yocto/sources/poky/../meta-vitis \
  /work/yocto/sources/meta-vd100_v3 \
  /work/yocto/sources/workspace \
  "
```

## conf/distro/vd100.conf
```bitbake
require conf/distro/amd-edf.conf

DISTRO = "vd100"
DISTRO_NAME = "VD100 Linux"
VD100_DISTRO_VERSION = "1.3"
VD100_DISTRO_VERSION_MINOR = "0"
DISTRO_CODENAME = "versal"
VD100_DISTRO_VER_TYPE="development"

#MACHINEOVERRIDES =. "versal:"

# This will be set in local.conf for CI builds
VD100_DISTRO_VER_BUILD ?= "${@'${METADATA_REVISION}' if d.getVar('METADATA_REVISION') != '<unknown>' else 'unknown'}"

# Follow the Poky format of <Version>+<type>-<date>
DISTRO_VERSION = "${VD100_DISTRO_VERSION}${VD100_DISTRO_VERSION_MINOR}+${VD100_DISTRO_VER_TYPE}-${VD100_DISTRO_VER_BUILD}"

SDK_VERSION := "-${DISTRO_VERSION}"
MAINTAINER = "Adilson Dias <https://github.com/adilsondias-engineer/versal-ai-edge-vd100-linux>"
SDK_NAME_PREFIX = "vd100"
SDK_NAME = "${SDK_NAME_PREFIX}-${SDKMACHINE}-${IMAGE_BASENAME}-${TUNE_PKGARCH}-${MACHINE}"
SDKPATH = "/opt/${SDK_NAME_PREFIX}/${SDK_VERSION}"
SDKEXTPATH = "~/${SDK_NAME_PREFIX}_sdk/${DISTRO_VERSION}"
SDK_INCLUDE_NATIVESDK = "1"

DISTRO_VERSION[vardepsexclude] = "DATE"
SDK_VERSION[vardepsexclude] = "DATE"

# Define the default hostname
hostname:pn-base-files:vd100 = "vd100"
hostname:pn-base-files = "vd100"

TARGET_VENDOR = "-vd100"

DISTRO_FEATURES:append = " ${AMD-EDF_DISTRO_FEATURES}"

IMAGE_CLASSES += "extrausers"
EXTRA_USERS_PARAMS = "\
    useradd -p '' vd100-usr;passwd-expire vd100-usr; \
    groupadd -r aie; \
    groupadd -r wayland; \
    groupadd -r pldev; \
    usermod -a -G pldev,aie,audio,input,video,wayland vd100-usr; \
    useradd -m -G sudo adilson; \
    usermod -p '\$6\$t3D07fSzxGsY23wR\$z5GjOzX7cPGErVT1HV1Y8HP0K/88t/hENEJhQSOKesj4vUBOxb.fzbE7.cZTZssQpx613lYKlW6WWkb9sMLSC0' adilson; \
    usermod -a -G pldev,aie,audio,input,video,wayland adilson; \
    "
USERADDEXTENSION:append = " amd-useradd-sudoers"
EXTRA_USERS_SUDOERS = "vd100-usr ALL=(ALL) ALL; adilson ALL=(ALL) ALL;"
```

## conf/layer.conf
```bitbake
# We have a conf and classes directory, add to BBPATH
CONF_VERSION = "5"
BBPATH .= ":${LAYERDIR}"
BBFILES += "${LAYERDIR}/recipes-*/*/*.bb \
            ${LAYERDIR}/recipes-*/*/*.bbappend"

BBFILE_COLLECTIONS += "meta-vd100"
BBFILE_PATTERN_meta-vd100 := "^${LAYERDIR}/"
BBFILE_PRIORITY_meta-vd100 := "20"
LAYERSERIES_COMPAT_meta-vd100 = "scarthgap"
```

## conf/machine/configs/Kconfig
```kconfig
mainmenu "System Configuration"
config SUBSYSTEM_TYPE_LINUX
        bool
        default y
        select SYSTEM_VERSAL

config SYSTEM_VERSAL
        bool "VERSAL Configuration"
        help
          VERSAL Configuration for the project.
          All these config options will be in /work/yocto/sources/meta-vd100_v3/conf/machine/config

config SUBSYSTEM_VARIANT_VERSALAI-EDGE
        bool
        default y
        help

config SUBSYSTEM_SDT_FLOW
        bool
        default y
        help

source /work/yocto/sources/meta-vd100_v3/conf/machine/configs/Kconfig.main
```

## conf/machine/include/versal-generic-xcve2302/versal-generic-xcve2302-microblaze-psm-features.conf
```bitbake
MACHINE_FEATURES = "cframe cfupmc common csudma emacps gpiops iicps intc iomodule ipipsu qspipsu rtcpsu sdps sysmonpsv tmr-inject tmr-manager trngpsv ttcps uartlite uartpsv usbpsu zdma"
```

## conf/machine/versal-generic-xcve2302.conf
```bitbake
#@TYPE: Machine
#@NAME: versal-generic-xcve2302
#@DESCRIPTION: Machine configuration for the versal-generic-xcve2302 boards.


BBMULTICONFIG += "versal-generic-xcve2302-microblaze-pmc versal-generic-xcve2302-microblaze-psm"

#### Preamble
MACHINEOVERRIDES =. "${@['', 'versal-generic-xcve2302:']['versal-generic-xcve2302' !='${MACHINE}']}"
#### Regular settings follow
TUNEFILE[microblaze-pmc] = "conf/machine/include/versal-generic-xcve2302/microblaze.inc"
TUNEFILE[microblaze-psm] = "conf/machine/include/versal-generic-xcve2302/microblaze.inc"

# Platform Loader and Manager
PLM_DEPENDS = ""
PLM_MCDEPENDS = "mc::versal-generic-xcve2302-microblaze-pmc:plm-firmware:do_deploy"
PLM_DEPLOY_DIR = "${TMPDIR}-versal-generic-xcve2302-microblaze-pmc/deploy/images/${MACHINE}"

# PSM Firware
PSM_DEPENDS = ""
PSM_MCDEPENDS = "mc::versal-generic-xcve2302-microblaze-psm:psm-firmware:do_deploy"
PSM_FIRMWARE_DEPLOY_DIR = "${TMPDIR}-versal-generic-xcve2302-microblaze-psm/deploy/images/${MACHINE}"

# Set the default (linux) domain device tree
CONFIG_DTFILE_DIR := "${@bb.utils.which(d.getVar('BBPATH'), 'conf/dts/versal-generic-xcve2302')}"
CONFIG_DTFILE ?= "${CONFIG_DTFILE_DIR}/cortexa72-linux.dts"
CONFIG_DTFILE[vardepsexclude] += "CONFIG_DTFILE_DIR"

# Yocto arm-trusted-firmware(TF-A) variables
TFA_CONSOLE ?= "pl011"
TFA_BL33_LOAD ?= "0x8000000"

# Set DDR Base address for u-boot-xlnx-scr variables
DDR_BASEADDR ?= "0x0"
SKIP_APPEND_BASEADDR ?= "0"

# Yocto KERNEL Variables
UBOOT_ENTRYPOINT  ?= "0x200000"
UBOOT_LOADADDRESS ?= "0x200000"

# Yocto MACHINE_FEATURES Variable
MACHINE_FEATURES += "vdu fpga-overlay"

# Required generic machine inclusion
require conf/machine/versal-generic.conf

# This is an 'SDT' based BSP
XILINX_WITH_ESW = "sdt"

# Original SDT artifacts URL
SDT_URI = "file:///work/vd100-aie-pipeline/vd100_pipeline_platform/hw/sdt"
SDT_URI[S] = "${WORKDIR}/work/vd100-aie-pipeline/vd100_pipeline_platform/hw/sdt"

# Set the system device trees
SYSTEM_DTFILE_DEPENDS = "sdt-artifacts"
SYSTEM_DTFILE_DIR = "${RECIPE_SYSROOT}${datadir}/sdt/${MACHINE}"
SYSTEM_DTFILE = "${SYSTEM_DTFILE_DIR}/system-top.dts"

# Load the dynamic machine features
include conf/machine/include/versal-generic-xcve2302/${BB_CURRENT_MC}-features.conf
LIBXIL_CONFIG = "conf/machine/include/versal-generic-xcve2302/${BB_CURRENT_MC}-libxil.conf"

# Versal PDI
PDI_PATH_DEPENDS = "sdt-artifacts"
PDI_PATH_DIR = "${RECIPE_SYSROOT}${datadir}/sdt/${MACHINE}"
PDI_PATH = "${PDI_PATH_DIR}/vpl_gen_fixed.pdi"

# Update bootbin to use proper device tree
BIF_PARTITION_IMAGE[device-tree] = "${RECIPE_SYSROOT}/boot/devicetree/${@os.path.basename(d.getVar('CONFIG_DTFILE').replace('.dts', '.dtb'))}"

# Remap boot files to ensure the right device tree is listed first
IMAGE_BOOT_FILES =+ "devicetree/${@os.path.basename(d.getVar('CONFIG_DTFILE').replace('.dts', '.dtb'))}"
IMAGE_BOOT_FILES:append = " system.dtb"

IMAGE_EFI_BOOT_FILES =+ "devicetree/${@os.path.basename(d.getVar('CONFIG_DTFILE').replace('.dts', '.dtb'))}"
IMAGE_EFI_BOOT_FILES:append = " system.dtb"

#### No additional settings should be after the Postamble
#### Postamble
PACKAGE_EXTRA_ARCHS:append = "${@['', ' versal_generic_xcve2302']['versal-generic-xcve2302' != '${MACHINE}']}"
```
